## components/shell/Kconfig
```kconfig
config SHELL
    bool "Enable Shell"
    default n
    depends on DEBUG_VERSION
    select USE_SHELL
    help
      Answer Y to enable LiteOS support shell cmd.

config USE_SHELL
    bool
    default n

menu "Functionality of Shell"
    depends on SHELL

config SHELL_PRIO
    int "Shell Task Priority"
    default 3
    range 1 31
    depends on SHELL

config SHELL_LK
    bool "Enable Shell lk"
    default y
    depends on DEBUG_VERSION && SHELL
    help
      Answer Y to enable LiteOS support shell lk.

config SHELL_DMESG
    bool "Enable Shell dmesg"
    default n
    depends on DEBUG_VERSION && SHELL && SHELL_CMD_DEBUG
    help
      Answer Y to enable LiteOS support shell dmesg.

config SHELL_AFFINITY
      bool "Shell Task Affinity"
      default n
      depends on SHELL && KERNEL_SMP

config SHELL_AFFINITY_CORE
      int "Shell Task Affinity Core Num"
      default 1
      range 1 KERNEL_CORE_NUM
      depends on SHELL && KERNEL_SMP && SHELL_AFFINITY
endmenu
```

## components/trace/Kconfig
```kconfig
config KERNEL_TRACE
    bool "Enable Trace Feature"
    default n
    select DEBUG_HOOK

config TRACE_MSG_EXTEND
    bool "Enable Record more extended content"
    default n
    depends on KERNEL_TRACE

config TRACE_FRAME_CORE_MSG
    bool "Record cpuid, hardware interrupt status, task lock status"
    default n
    depends on TRACE_MSG_EXTEND

config TRACE_FRAME_EVENT_COUNT
    bool "Record event count, which indicate the sequence of happened events"
    default n
    depends on TRACE_MSG_EXTEND

choice
    prompt "Trace work mode"
    default RECORDER_MODE_OFFLINE
    depends on KERNEL_TRACE

config RECORDER_MODE_ONLINE
    bool "Online mode"
    select TRACE_CLIENT_INTERACT

config RECORDER_MODE_OFFLINE
    bool "Offline mode"

endchoice

config TRACE_CLIENT_INTERACT
    bool "Enable Trace Client Visualization and Control"
    default n
    depends on KERNEL_TRACE

choice
    prompt "Trace Pipeline for Data Transmission"
    depends on TRACE_CLIENT_INTERACT

config TRACE_PIPELINE_SERIAL
    bool "Via Serial"

endchoice

choice
    prompt "Trace Control"
    default TRACE_CONTROL_VIA_SHELL
    depends on TRACE_CLIENT_INTERACT
    help
      If you wish to control Trace's start/stop etc.,dynamically by Trace Client.

config TRACE_CONTROL_VIA_SHELL
    bool "Via Shell"
    select LOSCFG_SHELL

config TRACE_CONTROL_AGENT
    bool "Via Trace Agent Task"

endchoice
```
